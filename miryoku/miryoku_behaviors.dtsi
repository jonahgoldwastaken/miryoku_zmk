// Copyright 2022 Manna Harbour
// https://github.com/manna-harbour/miryoku

/ {
  behaviors {
#if defined(MIRYOKU_TIMELESS_HRM)
    // Hold-taps tuned on recorded typing (tools/hrm-debug, scenarios.py).
    //
    // Holds are decided purely by how long the key is held (tap-preferred):
    // the measured gap between taps and intended holds is wide and stable,
    // while key order is not (keys are released nearly simultaneously, and
    // right-half events arrive a few ms late over BLE).
    //   letters / home-row-mod keys typed as letters: held <= 128 ms
    //   home-row mods meant as Cmd/Alt/Ctrl/Shift:     held >= 175 ms
    //   thumb keys typed as Space/Enter/...:           held <= 149 ms
    //   thumb keys meant as layers:                    held >= 224 ms
    // No require-prior-idle-ms and no positional rules: holding is never
    // decided by the previous key or by which hand the other key is on, so
    // rolling from Space into Shift, Esc into a vim capital, or using a mod
    // with a key on the same hand all behave the same.

    // Home-row mods (all modifiers, both hands).
    u_mt: u_mt {
      compatible = "zmk,behavior-hold-tap";
      #binding-cells = <2>;
      flavor = "tap-preferred";
      tapping-term-ms = <150>;
      quick-tap-ms = <175>;  // tap then hold repeats the letter
      bindings = <&kp>, <&kp>;
    };
    // Layer-taps (thumbs, bottom-row pinkies).
    u_lt: u_lt {
      compatible = "zmk,behavior-hold-tap";
      #binding-cells = <2>;
      flavor = "tap-preferred";
      tapping-term-ms = <180>;
      bindings = <&mo>, <&kp>;
    };
#else
    u_mt: u_mt {
      compatible = "zmk,behavior-hold-tap";
      #binding-cells = <2>;
      tapping-term-ms = <U_TAPPING_TERM>;
      flavor = "tap-preferred";
      bindings = <&kp>, <&kp>;
    };
    u_lt: u_lt {
      compatible = "zmk,behavior-hold-tap";
      #binding-cells = <2>;
      tapping-term-ms = <U_TAPPING_TERM>;
      flavor = "tap-preferred";
      bindings = <&mo>, <&kp>;
    };
#endif
  };
};
